//
// Created by zmake on 24-12-8.
//
#include "HAL.h"
#include <WiFi.h>
#include <PubSubClient.h>
#include <IRsend.h>

static WiFiClient espClient;           // 创建一个客户端
static PubSubClient client(espClient); // 创建一个发布客户端
static IRsend irsend(CONFIG_IRLED_PIN);     // Set the GPIO to be used to sending message

extern HAL::SHT_Info_t sht_info;

static const uint16_t irTestRawLen = 279;
uint16_t irHeatOnArray[irTestRawLen] = {9008, 4480, 550, 554, 572, 528, 572, 1632, 572, 1632, 598, 500, 576, 526, 576, 528,
                                  572, 528, 538, 1664, 576, 528, 570, 1632, 578, 526, 574, 528, 536, 544, 556, 540, 512,
                                  592, 558,
                                  546, 552, 542, 560, 538, 576, 526, 578, 524, 574, 1632, 576, 524, 578, 1626, 576, 526,
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                                  1670, 532, 570, 532, 1672, 532};  // GREE
uint8_t state[8] = {0x0C, 0x05, 0xA0, 0x50, 0x10, 0x20, 0x00, 0xE0};


static uint16_t irHeatOffArray[irTestRawLen] = {8938, 4548, 602, 500, 600, 500, 572, 1632, 602, 498, 570, 534, 604, 496,
                                                652, 486, 576,
                                                522, 528, 1696, 570, 512, 552, 1670, 572, 512, 578, 522, 510, 586, 576,
                                                526, 600, 502,
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                                                536, 566, 534, 566, 536};  // GREE



static void mqtt_callback(char *topic, byte *payload, unsigned int length) {
    Serial.print("Message arrived [");
    Serial.print(topic);
    Serial.print("] ");
    for (int i = 0; i < length; i++) {
        Serial.print((char) payload[i]);
    }
    Serial.println();
    //处理接收到的消息
    //判断消息内容控制灯的开关，如果是on则打开，如果是off则关闭
    if ((char) payload[0] == 'o' && (char) payload[1] == 'n') {
        // TODO:控制灯开
        // irsend.sendNEC(0xFF38C7, 32);
//        irsend.sendGree(0x0C05A050102000E0, 64, 1);
        irsend.sendRaw(irHeatOnArray, irTestRawLen, 38);
    } else if ((char) payload[0] == 'o' && (char) payload[1] == 'f' && (char) payload[2] == 'f') {
        // TODO:控制灯关
        irsend.sendRaw(irHeatOffArray, irTestRawLen, 38);
    }
}

static void mqtt_report(void) {
    char msg[50];
    sprintf(msg, R"({"temperature":%f,"humidity":%f})", sht_info.temp, sht_info.humi);
    client.publish(CONFIG_MQTT_PUB_TOPIC, msg);
}

static void mqtt_report_task(void *pvParameters) {
    while (1) {
        vTaskDelay(1000 * 5 / portTICK_PERIOD_MS);
        if (client.connected()) {
            mqtt_report();
        }
    }
}


void HAL::MQTT_Init() {

    client.setServer(CONFIG_MQTT_SERVER, CONFIG_MQTT_PORT); //设置客户端连接的服务器,连接Onenet服务器

    client.connect(CONFIG_MQTT_DEVICE_ID); //客户端连接到指定的产品的指定设备.同时输入鉴权信息
    if (client.connected()) {
        Serial.println("MQTT Server is connected!"); //判断一下是不是连好了.
    }
    client.subscribe(CONFIG_MQTT_SUB_TOPIC); //订阅主题
    client.setCallback(mqtt_callback); //设置回调函数
    irsend.begin();
    xTaskCreate(mqtt_report_task, "mqtt_report_task", 4096, NULL, 5, NULL);
}

void HAL::MQTT_Update() {
    client.loop(); //保持连接
}